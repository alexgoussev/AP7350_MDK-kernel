;;-> # Option: Serial Wire or Parallel JTAG
;; OPT_JTAG
;; 0: Parallel
;; 1: Serial Wire
&OPT_JTAG=0

;;-> # Option: Number of CPUs to be connected
;; OPT_NR_CPUS
&OPT_NR_CPUS=1

;;-> # Option: RAM booting or EMMC booting
;; OPT_RAM_BOOT
;; 0: EMMC booting
;; 1: RAM booting
&OPT_RAM_BOOT=0

;;-> # Option: FPGA with LCM
;; OPT_WITH_LCM
;; 0: LCM is not exist
;; 1: LCM is exist
&OPT_WITH_LCM=0


&Project="evb6580"
&OutProjectPath="../../../../out/target/product/&Project/obj/BOOTLOADER_OBJ/build-&Project"
;&OutProjectPath="../build-&Project"


SYStem.Down
SYStem.Reset
SYStem.Option EnReset ON
SYStem.Option ResBreak OFF
SYStem.Option WaitReset OFF
SYStem.JtagClock 10.MHz

IF &OPT_JTAG==0
(
    SYStem.Config SWDP OFF
)
ELSE IF &OPT_JTAG==1
(
    SYStem.Config SWDP ON
)

SYSTEM.CPU CortexA7MPCore
SYStem.Config CORENUMBER &OPT_NR_CPUS
SYStem.Config COREBASE 0x80070000

SYStem.Up

MMU.OFF

SETUP.IMASKHLL ON
SETUP.IMASKASM ON

; Disable DABORT and PABORT breakpoint
TrOnchip.Set dabort off
TrOnchip.Set pabort off
TrOnchip.Set undef off
TrOnchip.Set irq off

; Set default breakpoints to HW
Break.SELect Program OnChip
Break.SELect Read OnChip
Break.SELect Write OnChip

;
; board init
;
; Disable acinactm
D.S c:0x1020011C %LE %LONG 0x1
D.S c:0x1020011C %LE %LONG 0x1

; Disable wdt
D.S c:0x10007000 %LE %LONG 0x22000064

; setup boot augu from PL
IF &OPT_RAM_BOOT==1
(

D.S SD:0x10200000 %LE %LONG 0x00000020  ;L2C share SRAM
d.load.elf MT6580_ETT.elf  
go

wait 2000.ms
break

    IF &OPT_WITH_LCM==1
    (
        do MT6735_DSI0_B60384.cmm
    )

    R.S R4 0x8007f288
    D.S SD:0x8007f288 %LE %LONG 0x504c504c  ;maggic_number
    D.S SD:0x8007f28c %LE %LONG 0x00000000  ;boot_mode
    D.S SD:0x8007f290 %LE %LONG 0x00000000  ;e_flag
    D.S SD:0x8007f294 %LE %LONG 0x11003000  ;log_port
    D.S SD:0x8007f298 %LE %LONG 0x000e1000  ;log_baudrate
    D.S SD:0x8007f29c %LE %LONG 0xffff0201  ;reserved[2], part_num, log_enable
    D.S SD:0x8007f2a0 %LE %LONG 0x00000002  ;dram_rank_num
    D.S SD:0x8007f2a4 %LE %LONG 0x10000000  ;dram_rank_size[0]
    D.S SD:0x8007f2a8 %LE %LONG 0x10000000  ;dram_rank_size[1]
    D.S SD:0x8007f2ac %LE %LONG 0xdfffffff  ;dram_rank_size[2]
    D.S SD:0x8007f2b0 %LE %LONG 0xfffffdff  ;dram_rank_size[3]
    D.S SD:0x8007f2b4 %LE %LONG 0xffffffff  
    D.S SD:0x8007f2b8 %LE %LONG 0x00000002  ;mblock_num
    D.S SD:0x8007f2bc %LE %LONG 0x00000000  
    D.S SD:0x8007f2c0 %LE %LONG 0x40000000  ;mblock[0].start
    D.S SD:0x8007f2c4 %LE %LONG 0x00000000  
    D.S SD:0x8007f2c8 %LE %LONG 0x10000000  ;mblock[0].size
    D.S SD:0x8007f2cc %LE %LONG 0x00000000  
    D.S SD:0x8007f2d0 %LE %LONG 0x00000000  ;mblock[0].rank
    D.S SD:0x8007f2d4 %LE %LONG 0x00000000  
    D.S SD:0x8007f2d8 %LE %LONG 0x50000000  ;mblock[1].start
    D.S SD:0x8007f2dc %LE %LONG 0x00000000  
    D.S SD:0x8007f2e0 %LE %LONG 0x0fe00000  ;mblock[1].size
    D.S SD:0x8007f2e4 %LE %LONG 0x00000000
    D.S SD:0x8007f2e8 %LE %LONG 0x00000001  ;mblock[1].rank
    D.S SD:0x8007f2ec %LE %LONG 0x00000000
    D.S SD:0x8007f2f0 %LE %LONG 0x00000000  ;mblock[2].start
    D.S SD:0x8007f2f4 %LE %LONG 0x00000000
    D.S SD:0x8007f2f8 %LE %LONG 0x00000000  ;mblock[2].size
    D.S SD:0x8007f2fc %LE %LONG 0x00000000
    D.S SD:0x8007f300 %LE %LONG 0x00000000  ;mblock[2].rank
    D.S SD:0x8007f304 %LE %LONG 0x00000000
    D.S SD:0x8007f308 %LE %LONG 0x00000000  ;mblock[3].start
    D.S SD:0x8007f30c %LE %LONG 0x00000000
    D.S SD:0x8007f310 %LE %LONG 0x00000000  ;mblock[3].size
    D.S SD:0x8007f314 %LE %LONG 0x00000000
    D.S SD:0x8007f318 %LE %LONG 0x00000000  ;mblock[3].rank
    D.S SD:0x8007f31c %LE %LONG 0x00000000
    D.S SD:0x8007f320 %LE %LONG 0x00000002  ;orig_dram_info.rank_num
    D.S SD:0x8007f324 %LE %LONG 0xffffffff
    D.S SD:0x8007f328 %LE %LONG 0x40000000  ;rank_info[0].start
    D.S SD:0x8007f32c %LE %LONG 0x00000000
    D.S SD:0x8007f330 %LE %LONG 0x10000000  ;rank_info[0].size
    D.S SD:0x8007f334 %LE %LONG 0x00000000
    D.S SD:0x8007f338 %LE %LONG 0x50000000  ;rank_info[1].start
    D.S SD:0x8007f33c %LE %LONG 0x00000000
    D.S SD:0x8007f340 %LE %LONG 0x10000000  ;rank_info[1].size
    D.S SD:0x8007f344 %LE %LONG 0x00000000
    D.S SD:0x8007f348 %LE %LONG 0xffffffff  ;rank_info[2].start
    D.S SD:0x8007f34c %LE %LONG 0xffffffff
    D.S SD:0x8007f350 %LE %LONG 0xfffeffff  ;rank_info[2].size
    D.S SD:0x8007f354 %LE %LONG 0xfffffffd
    D.S SD:0x8007f358 %LE %LONG 0xffffffff  ;rank_info[3].start
    D.S SD:0x8007f35c %LE %LONG 0xffffffff
    D.S SD:0x8007f360 %LE %LONG 0xffffffff  ;rank_info[3].size
    D.S SD:0x8007f364 %LE %LONG 0xffffffff
    D.S SD:0x8007f368 %LE %LONG 0x00000000  ;lca_reserved_mem.start
    D.S SD:0x8007f36c %LE %LONG 0x00000000
    D.S SD:0x8007f370 %LE %LONG 0x00000000  ;lca_reserved_mem.size
    D.S SD:0x8007f374 %LE %LONG 0x00000000
    D.S SD:0x8007f378 %LE %LONG 0x5fe00000  ;tee_reserved_mem.start
    D.S SD:0x8007f37c %LE %LONG 0x00000000
    D.S SD:0x8007f380 %LE %LONG 0x00200000  ;tee_reserved_mem.size
    D.S SD:0x8007f384 %LE %LONG 0x00000000
    D.S SD:0x8007f388 %LE %LONG 0x00000000  ;boot_reason
    D.S SD:0x8007f38c %LE %LONG 0x00000000  ;meta_com_type
    D.S SD:0x8007f390 %LE %LONG 0x00000000  ;meta_com_id
    D.S SD:0x8007f394 %LE %LONG 0x00000000  ;boot_time
    D.S SD:0x8007f398 %LE %LONG 0xffffffff  ;da_info.addr
    D.S SD:0x8007f39c %LE %LONG 0xffffffff  ;da_info.arg1
    D.S SD:0x8007f3a0 %LE %LONG 0xffffdfff  ;da_info.arg2
    D.S SD:0x8007f3a4 %LE %LONG 0xdfffffff  ;da_info.len
    D.S SD:0x8007f3a8 %LE %LONG 0xffffffef  ;da_info.sig_len
    D.S SD:0x8007f3ac %LE %LONG 0xffffffff  ;sec_limit.magic_num
    D.S SD:0x8007f3b0 %LE %LONG 0xffffdfff  ;sec_limit.forbid_mode
    D.S SD:0x8007f3b4 %LE %LONG 0x40079a84  ;part_info pointer
    D.S SD:0x8007f3b8 %LE %LONG 0xfffffffd  ;md_type
    D.S SD:0x8007f3bc %LE %LONG 0x00000000  ;ddr_reserve_enable
    D.S SD:0x8007f3c0 %LE %LONG 0x00000000  ;ddr_reserve_success
    D.S SD:0x8007f3c4 %LE %LONG 0x00199880  ;dram_buf_size
    D.S SD:0x8007f3c8 %LE %LONG 0x11003000  ;meta_uart_port
    D.S SD:0x8007f3cc %LE %LONG 0x00000000  ;smc_boot_opt
    D.S SD:0x8007f3d0 %LE %LONG 0x00000003  ;lk_boot_opt
    D.S SD:0x8007f3d4 %LE %LONG 0x00000003  ;kernel_boot_opt
    D.S SD:0x8007f3d8 %LE %LONG 0x0012c000  ;non_secure_sram_addr
    D.S SD:0x8007f3dc %LE %LONG 0x00004000  ;non_secure_sram_size	
)

;print "loading logo image"
;&logo_addr=0x8D900000;
;d.load.binary ../../../../mediatek/custom/common/lk/logo/wvga/wvga_uboot.bmp &logo_addr
&pathlen=STRing.SCAN(OS.PWD(),"&searchStr",0)+STRing.LEN("&searchStr")
&ctpPath=STRing.MID(OS.PWD(), 0, &pathlen)
print "loading lk image"
IF &OPT_RAM_BOOT==0
(
	Data.Load.ELF &OutProjectPath/lk /long /nocode /RELPATH /StripPART "&searchStr" /PATH "&ctpPath"
)
ELSE
(
	Data.Load.ELF &OutProjectPath/lk /long  /StripPART "&searchStr" /PATH "&ctpPath"
)

Y.SPATH.RESET  ; reset all source path
Y.SPATH.SRD ..\..\..\..\bootable\bootloader\lk\app
Y.SPATH.SRD ..\..\..\..\bootable\bootloader\lk\app\mt_boot
Y.SPATH.SRD ..\..\..\..\bootable\bootloader\lk\arch\arm
Y.SPATH.SRD ..\..\..\..\bootable\bootloader\lk\dev
Y.SPATH.SRD ..\..\..\..\bootable\bootloader\lk\include
Y.SPATH.SRD ..\..\..\..\bootable\bootloader\lk\kernel
Y.SPATH.SRD ..\..\..\..\bootable\bootloader\lk\lib
Y.SPATH.SRD ..\..\..\..\bootable\bootloader\lk\platform\mt6580

;Core.Select 0

Data.List

enddo


